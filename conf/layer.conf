## conf/layer.conf
```bitbake
# We have a conf and classes directory, add to BBPATH
BBPATH .= ":${LAYERDIR}"

# We have a packages directory, add to BBFILES
BBFILES += "${LAYERDIR}/recipes-*/*/*.bb \
            ${LAYERDIR}/recipes-*/*/*.bbappend"

BBFILE_COLLECTIONS += "tqs-arm"
BBFILE_PATTERN_tqs-arm := "^${LAYERDIR}/"
BBFILE_PRIORITY_tqs-arm = "6"
```

## conf/machine/qemuarmv6.conf
```bitbake
#@TYPE: Machine
#@NAME: ARM-Versatile PB (ARM1136JFS)
#@COM: qemuarmv6
#@SOC: QEMU
#@DESCRIPTION: arm_versatile_1136jfs

require conf/machine/include/qemu.inc
#require conf/machine/include/tune-arm926ejs.inc
require conf/machine/include/tune-arm1136jf-s.inc

PREFERRED_PROVIDER_linux-libc-headers ?= "linux-libc-headers-tqs"
PREFERRED_PROVIDER_virtual/kernel = "linux-tqs"

KERNEL_IMAGETYPE = "zImage"

SERIAL_CONSOLE = "115200 ttyAMA0"
```

## conf/machine/tqma35.conf
```bitbake
#@TYPE: Machine
#@NAME: TQ System i.MX35 Embedded module (tqma35)
#@SOC: i.MX35
#@DESCRIPTION: Machine configuration for TQ System i.MX35 Embedded module (tqma35)

include conf/machine/include/soc-family.inc
include conf/machine/include/imx-base.inc
require conf/machine/include/tune-arm1136jf-s.inc

SOC_FAMILY = "mx3:mx35"

PREFERRED_PROVIDER_virtual/kernel_mx3 = "linux-tqs"
PREFERRED_PROVIDER_u-boot = "u-boot-tqs"

UBOOT_MACHINE = "TQMa35_config"
UBOOT_SUFFIX = "bin"
UBOOT_MAKE_TARGET = "u-boot.${UBOOT_SUFFIX}"
# have to evaluate: UBOOT_BINARY = "u-boot.${UBOOT_SUFFIX}"

# have to evaluate: GUI_MACHINE_CLASS = "bigscreen"
# have to evaluate: GUI_MACHINE_CLASS = "smallscreen"

IMAGE_ROOTFS_SIZE = "29696"

IMAGE_FSTYPES += "jffs2"
JFFS2_ERASEBLOCK = "0x20000"

# have to evaluate: IMAGE_FSTYPES = "ubi jffs2 tar.bz2"
# have to evaluate: MKUBIFS_ARGS = "-m 2048 -e 129024 -c 2030"
# have to evaluate: UBINIZE_ARGS = "-m 2048 -p 128KiB -s 512"

SERIAL_CONSOLE = "115200 ttymxc2"

MACHINE_FEATURES += "ext2 ext3 screen"
```
